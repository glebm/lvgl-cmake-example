## src/platforms/sdl2/lvgl_defconfig
```kconfig
CONFIG_LV_USE_LOG=y
# CONFIG_LV_FONT_MONTSERRAT_14 is not set
CONFIG_LV_FONT_DEFAULT_MONTSERRAT_20=y
CONFIG_LV_USE_THEME_MONO=y
CONFIG_LV_FS_DEFAULT_DRIVE_LETTER=65
CONFIG_LV_USE_FS_STDIO=y
CONFIG_LV_FS_STDIO_LETTER=65
CONFIG_LV_USE_QRCODE=y
CONFIG_LV_USE_SDL=y
# CONFIG_LV_BUILD_EXAMPLES is not set
```
